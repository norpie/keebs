/*
 * Custom behaviors for BT60 v2
 * Inspired by urob's ZMK configuration
 */

// Include zmk-helpers for simplified behavior definitions
#include "../../zmk-helpers/include/zmk-helpers/helper.h"

// Timing definitions for consistent behavior across all custom keys
#define QUICK_TAP_MS 175
#define TAPPING_TERM_MS 280
#define PRIOR_IDLE_MS 150

// Key position definitions for BT60 v2 (60% layout)
#define KEYS_L  0  1  2  3  4  5  6 \
               14 15 16 17 18 19 20 \
               28 29 30 31 32 33 34

#define KEYS_R  7  8  9 10 11 12 13 \
               21 22 23 24 25 26 27 \
               35 36 37 38 39 40 41

#define THUMBS 42 43 44 45 46 47 48 49 50 51 52 53 54 55 56 57 58 59 60 61 62 63

// Homerow mod behaviors using zmk-helpers
ZMK_HOLD_TAP(hml,
    flavor = "balanced";
    tapping-term-ms = <TAPPING_TERM_MS>;
    quick-tap-ms = <QUICK_TAP_MS>;
    require-prior-idle-ms = <PRIOR_IDLE_MS>;
    bindings = <&kp>, <&kp>;
    hold-trigger-key-positions = <KEYS_R THUMBS>;
    hold-trigger-on-release;
)

ZMK_HOLD_TAP(hmr,
    flavor = "balanced";
    tapping-term-ms = <TAPPING_TERM_MS>;
    quick-tap-ms = <QUICK_TAP_MS>;
    require-prior-idle-ms = <PRIOR_IDLE_MS>;
    bindings = <&kp>, <&kp>;
    hold-trigger-key-positions = <KEYS_L THUMBS>;
    hold-trigger-on-release;
)

/* Placeholder behaviors for future smart features:
 * These will be implemented later:
 * - Smart Caps Lock (tap: ESC, hold: CTRL, double-tap: caps-word)
 * - Magic Shift (adaptive shift behavior)
 * - Smart Number Row (tap: number, hold: F-key)
 * - Mod-morphs for shifted actions
 * - Smart Space Bar behavior
 * - Alt-Tab swapper
 */